## CMakeLists.txt
```
cmake_minimum_required(VERSION 3.8.2)
include_directories(include)
include($ENV{ZEPHYR_BASE}/cmake/app/boilerplate.cmake NO_POLICY_SCOPE)
project(NONE)

target_sources(app PRIVATE src/main-$ENV{TSIP_APP}.c)
target_sources(app PRIVATE src/sc.c)
target_sources(app PRIVATE src/sc_error.c)
target_sources(app PRIVATE src/sc_event.c)
target_sources(app PRIVATE src/sc_sensor.c)
```

## prj.conf
```kconfig
CONFIG_PRINTK=y
CONFIG_HEAP_MEM_POOL_SIZE=256
CONFIG_ASSERT=y
CONFIG_NO_OPTIMIZATIONS=y
CONFIG_DEBUG=y
CONFIG_NET_BUF=y
CONFIG_NET_BUF_USER_DATA_SIZE=64
CONFIG_CONSOLE_SHELL=y
CONFIG_KERNEL_SHELL=y
CONFIG_OBJECT_TRACING=y
CONFIG_THREAD_MONITOR=y
CONFIG_INIT_STACKS=y
```

## include/sc.h
```c
/*
 * Copyright 2018 Tuomas Kulve, <tuomas@kulve.fi>
 *
 * SPDX-License-Identifier: Apache-2.0
 */

/*
 * Snowcap framework common functions
 */

#ifndef SC_H
#define SC_H

#include <stdint.h>
#include <stdbool.h>
#include <stdio.h>
#include <string.h>

/* Snowcap framework includes */
#include "sc_event.h"
#include "sc_error.h"
#include "sc_sensor.h"

#include <zephyr.h>

typedef enum SC_THREAD_PRIORITY {
  SC_THREAD_PRIORITY_HIGH = 3,
  SC_THREAD_PRIORITY_MEDIUM = 5,
  SC_THREAD_PRIORITY_LOW = 7,
} SC_THREAD_PRIORITY;

bool sc_init(uint32_t subsystems);
void sc_halt(void);

#endif // SC_H
```

## include/sc_error.h
```c
/*
 * Copyright 2018 Tuomas Kulve, <tuomas@kulve.fi>
 *
 * SPDX-License-Identifier: Apache-2.0
 */

/**
 * @file
 * @brief Error logging and tracking
 *
 * All logged errors in the system must be unique. The error logging and
 * tracking module keeps track of the number of each error and provides the
 * timestamp of the last occurance.
 *
 * @defgroup sc_error Error logging
 * @ingroup sc_core
 * @{
 */

#ifndef SC_ERROR_H
#define SC_ERROR_H

#include "sc.h"

/**
 * @brief Representation of a single error type. Each error must be unique in the system.
 */
typedef struct sc_error_data {
  uint32_t count;
  int64_t ts;
  char *message;
} sc_error_data;

/**
 * @brief Register errors for a module.
 *
 * @param name Name of the module.
 * @param data An array of errors for the module. The error struct fields must
 * be initialized to zero except for the message that must be the name of the
 * error.
 * @param data_size Number of error elements in the data array.
 * @param module The index number of the module. This must be called when
 * logging the actual errors. This is only set if the registration succeeds.
 *
 * @retval true if successful.
 * @retval false if failed.
 */
bool sc_error_register(char *name, sc_error_data *data, uint8_t data_size, uint8_t *module);

/**
 * @brief Log an error.
 *
 * The module must be acquired first by calling sc_error_register.
 *
 * @param module Index of the module.
 * @param error Index of the error in the module's error list passed to sc_error_register.
 *
 * @retval true if successful.
 * @retval false if failed.
 */
void sc_error_log(uint8_t module, uint8_t error);

/**
 * @brief Log an error with one integer parameter.
 *
 * Same as sc_error_log but with additional integered parameter. The module must
 * be acquired first by calling sc_error_register.
 *
 * @param module Index of the module.
 * @param error Index of the error in the module's error list passed to
 * sc_error_register.
 * @param param Integer variable to be printed as a part of the error message.
 *
 * @retval true if successful.
 * @retval false if failed.
 */void sc_error_log_int(uint8_t module, uint8_t error, uint32_t param);

/**
 * @}
 */

#endif // SC_ERROR_H
```

## include/sc_event.h
```c
/*
 * Copyright 2018 Tuomas Kulve, <tuomas@kulve.fi>
 *
 * SPDX-License-Identifier: Apache-2.0
 */

/**
 * @file
 * @brief Event Loop
 *
 * The event loop implements the asynchronous core logic of the framework. It
 * enables different drivers and tasks to run asynchronously and notify the main
 * application once there is an event to react to.
 *
 * @defgroup sc_event_loop Event Loop
 * @ingroup sc_core
 * @{
*/

#ifndef SC_EVENT_H
#define SC_EVENT_H

#include "sc.h"

/** Callback for an event */
typedef void (*sc_event_cb)(void);

/**
 * @brief Initialize the event loop.
 *
 * Must be called before initializing other subsystems.
 *
 * @retval true if successful.
 * @retval false if failed.
 */
bool sc_event_init(void);

/**
 * @brief Post an event.
 *
 * The type must be registered first with sc_event_register_type (TODO: link)
 *
 * @param type Event type.
 *
 * @retval true if successful.
 * @retval false if failed.
 */
bool sc_event_post(uint8_t type);

/**
 * @brief Register a type
 *
 * Calling this function will return an index for the type. If one did not exist
 * yet, it was registered. If it was already registered, the index of that event
 * is returned.
 *
 * @param name Name of the event. The name must be a well-known name between the
 * caller and the callee.
 * @param type Index the type is returned in this pointer if the retval is true.
 *
 * @retval true if successful.
 * @retval false if failed.
 */
bool sc_event_register_type(const char *name, uint8_t *type);

/**
 * @brief Register a callback for an event type.
 *
 * The callback will be called from the Event Loop's thread. The callback must
 * return as soon as possible to unblock handling of other events.
 *
 * The type must be registered first with sc_event_register_type (TODO: link)
 *
 * @param type Event type.
 * @param func Callback function.
 *
 * @retval true if successful.
 * @retval false if failed.
 */
bool sc_event_register_cb(uint8_t type, sc_event_cb func);

/**
 * @brief A convenience function to register and event and assign a callback.
 *
 * Internally this calls first sc_event_register_type() and then
 * sc_event_register_cb(). Event type is not returned.
 *
 * @retval true if successful.
 * @retval false if failed.
 */
bool sc_event_register_type_cb(const char *name, sc_event_cb func);

/**
 * @}
 */

#endif // SC_EVENT_H
```

## include/sc_sensor.h
```c
/*
 * Copyright 2019 Tuomas Kulve, <tuomas@kulve.fi>
 *
 * SPDX-License-Identifier: Apache-2.0
 */

/**
 * @file
 * @brief Sensor framework for Zephyr's sensor API
 *
 * Support multiple sensors using Zephyr's sensor API. Provide events to the
 * main application using the event thread so that the main application doesn't
 * need to care about thread safety in its implementation.
 *
 * @{
 */

#ifndef SC_SENSOR_H
#define SC_SENSOR_H

#ifdef CONFIG_SENSOR

#include "sc.h"
#include <sensor.h>

/**
 * @brief Initialize the sensor subsystem.
 *
 * @retval true if successful.
 * @retval false if failed.
 */
bool sc_sensor_init(void);

/**
 * @brief Add a sensor to be polled with the given interval
 *
 * @param device_name Name of the device for device_get_binding().
 * @param channels Zephyr sensor channels to be polled.
 * @param channel_count Number of channels.
 * @param interval_ms Poll interval in milliseconds.
 * @param event_name Event to send when a new data is available.
 * @param index The index of the sensor if succesful.
  *
 * @retval true if successful.
 * @retval false if failed.
 */

bool sc_sensor_add(const char *device_name,
                   enum sensor_channel *channels,
                   uint8_t channel_count,
                   uint32_t interval_ms,
                   const char *event_name,
                   uint8_t *index);

/**
 * @brief Read the sensor value after receiving the event indicating a new value
 * is ready.
 *
 * @param index The index number of the sensor received with the sc_sensor_add
 * function.
 * @param value The returned values of the latest sensor read. The array
 * contains channel_count values listed with the sc_sensor_add function.
 *
 * @retval true if successful.
 * @retval false if failed.
 */
bool sc_sensor_get_value(uint8_t index, struct sensor_value *values);


/**
 * @brief Helper function for printing a sensor value to a buffer
 *
 * @param buf A pointer to the buffer to which the printing is done.
 * @param len Size of buffer in bytes.
 * @param val A pointer to a sensor_value struct holding the value
 *            to be printed.
 *
 * @return The number of characters printed to the buffer.
 *
 * Copied from:
 * https://github.com/zephyrproject-rtos/zephyr/blob/master/samples/sensor/bmi160/src/bmi160.c
 */
int sc_sensor_value_snprintf(char *buf, size_t len,
                             const struct sensor_value *val);
/**
 * @}
 */

#endif // CONFIG_SENSOR
#endif // SC_SENSOR_H
```

## src/main-sht3x.c
```c
/*
 * Copyright 2018 Tuomas Kulve, <tuomas@kulve.fi>
 *
 * SPDX-License-Identifier: Apache-2.0
 */

#include "sc.h"
#include <misc/printk.h>
#include <sensor.h>

static void event_sht3x_cb(void);
static void main_halt(void);

/* NOTE! This list must be in the same order as the error list below */
typedef enum sc_error_main {
  SC_ERROR_MAIN_EVENT_POST_FAIL = 0,
  SC_ERROR_MAIN_COUNT,
} sc_error_main;

/* NOTE! This list must be in the same order as the enum above */
static sc_error_data sc_error_list1[SC_ERROR_MAIN_COUNT] = {
  {0, 0, "sc_event_post failed"},
};

static uint8_t sht3x_index;

int main(void)
{
  // Register error module
  uint8_t error_module;
  if (sc_error_register("MAIN", sc_error_list1, ARRAY_SIZE(sc_error_list1), &error_module) == false) {
    sc_halt();
  }

  // Register event type and callback for the SHT3X sensor
  if (sc_event_register_type_cb("sht3x", &event_sht3x_cb) == false){
    main_halt();
  }

  uint32_t subsystems = 0;
  if (sc_init(subsystems) == false) {
    main_halt();
  }

  // List of channels on SHT3X
  enum sensor_channel channels[] = {
    SENSOR_CHAN_AMBIENT_TEMP,
    SENSOR_CHAN_HUMIDITY,
  };

  // Start measuring SHT3X sensor
  if (!sc_sensor_add("SHT3XD", channels, ARRAY_SIZE(channels), 60*1000, "sht3x", &sht3x_index)) {
    //main_halt();
  }

  // Main thread will loop forever. Event thread will execute callbacks.
  while(1) {
    //printk("Main thread idling\n");
    k_sleep(2000);
  }

  return 0;
}

static void event_sht3x_cb(void)
{
  static uint64_t seq = 0;

  // TODO: should use ARRAY_SIZE() etc. to match with the sc_sensor_add()
  struct sensor_value values[2];
  char temp[16], hum[16];

  if (!sc_sensor_get_value(sht3x_index, values)) {
    // TODO: Error logging
    return;
  }

  sc_sensor_value_snprintf(temp, sizeof(temp), &values[0]);
  sc_sensor_value_snprintf(hum, sizeof(hum), &values[1]);

  printk("m: hum[0]: %llu, %s, %s, %d, %d\n", seq, temp, hum, 0, 0);
  ++seq;
}

// TODO: implement sc_halt with an application specific halt function?
static void main_halt(void)
{
  // TODO: Blink big red warning light? Reset after a while?
  while(1) {};
}
```

## src/main-test.c
```c
/*
 * Copyright 2018 Tuomas Kulve, <tuomas@kulve.fi>
 *
 * SPDX-License-Identifier: Apache-2.0
 */

#include "sc.h"
#include <misc/printk.h>

static void event_test_cb(void);
static void main_halt(void);

/* NOTE! This list must be in the same order as the error list below */
typedef enum sc_error_main {
  SC_ERROR_MAIN_EVENT_POST_FAIL = 0,
  SC_ERROR_MAIN_COUNT,
} sc_error_main;

/* NOTE! This list must be in the same order as the enum above */
static sc_error_data sc_error_list1[SC_ERROR_MAIN_COUNT] = {
  {0, 0, "sc_event_post failed"},
};

int main(void)
{
  // Register error module
  uint8_t error_module;
  if (sc_error_register("MAIN", sc_error_list1, ARRAY_SIZE(sc_error_list1), &error_module) == false) {
    sc_halt();
  }

  // Register test event type and callback
  uint8_t testevent_type;
  if (sc_event_register_type("TESTMAIN", &testevent_type) == false){
    main_halt();
  }
  if (sc_event_register_cb(testevent_type, &event_test_cb) == false){
    main_halt();
  }

  uint32_t subsystems = 0;
  if (sc_init(subsystems) == false) {
    main_halt();
  }

  // Main thread will loop forever. Event thread will execute callbacks.
  while(1) {
    printk("Sending TESTMAIN from main!\n");
    if (sc_event_post(testevent_type) == false) {
      sc_error_log(error_module, SC_ERROR_MAIN_EVENT_POST_FAIL);
    }
    k_sleep(10000);
  }

  return 0;
}

static void event_test_cb(void)
{
  printk("TEST\n");
}

// TODO: implement sc_halt with an application specific halt function?
static void main_halt(void)
{
  // TODO: Blink big red warning light? Reset after a while?
  while(1) {};
}
```

## src/sc.c
```c
/*
 * Copyright 2018 Tuomas Kulve, <tuomas@kulve.fi>
 *
 * SPDX-License-Identifier: Apache-2.0
 */

#include "sc.h"
#include <shell/shell.h>

#ifdef CONFIG_SHELL
static int sc_shell_cmd_ping(const struct shell *shell, size_t argc, char **argv);
static int sc_shell_cmd_version(const struct shell *shell, size_t argc, char **argv);
#endif

bool sc_init(uint32_t subsystems)
{
  // TODO: initialize the subsystems properly
  (void) subsystems;

  /* The Event loop must be initialized before any other subsystem */
  if (sc_event_init() == false) {
    return false;
  }

  return true;
}


// TODO: implement sc_halt with an application specific halt function?
// Init to register a callback to call and if NULL, do a halt here?
void sc_halt(void)
{
  // TODO: loop for ever on debug builds, 10 ms on release builds?
  while(1) {};
}

#ifdef CONFIG_SHELL
static int sc_shell_cmd_ping(const struct shell *shell, size_t argc, char **argv)
{
  (void)argc;
  (void)argv;

  shell_print(shell, "pong");

  return 0;
}

SHELL_CMD_REGISTER(ping, NULL, "Ping pong", sc_shell_cmd_ping);

static int sc_shell_cmd_version(const struct shell *shell, size_t argc, char **argv)
{
  (void)argc;
  (void)argv;

  // TODO: use git hash?
  shell_print(shell, "0.1");

  return 0;
}
SHELL_CMD_REGISTER(version, NULL, "Shopw version number", sc_shell_cmd_version);
#endif
```

## src/sc_error.c
```c
/*
 * Copyright 2018 Tuomas Kulve, <tuomas@kulve.fi>
 *
 * SPDX-License-Identifier: Apache-2.0
 */

#include "sc_error.h"
#include <misc/printk.h>

#ifndef SC_ERROR_MODULE_MAX
#define SC_ERROR_MODULE_MAX 8
#endif

typedef struct sc_error_module_data {
  const char *name;
  sc_error_data *data;
  uint8_t data_size;
} sc_error_module_data;

sc_error_module_data sc_error_module_data_list[SC_ERROR_MODULE_MAX];
static void sc_error_log_ext(uint8_t module, uint8_t error, bool has_param, uint32_t param);

K_MUTEX_DEFINE(sc_error_module_data_mutex);

bool sc_error_register(char *name, sc_error_data *error_data, uint8_t data_size, uint8_t *module)
{
  if (name == NULL || name[0] == '\0' || error_data == NULL || data_size == 0) {
    // TODO: no asserts in error module, print error if possible, optionally with the module name
    return false;
  }

  k_mutex_lock(&sc_error_module_data_mutex, K_FOREVER);
  for (uint8_t i = 0; i < SC_ERROR_MODULE_MAX; ++i) {
    sc_error_module_data *data = &sc_error_module_data_list[i];
    if (data->name == NULL) {
      data->name = name;
      data->data = error_data;
      data->data_size = data_size;
      *module = i;
      k_mutex_unlock(&sc_error_module_data_mutex);
      return true;
    }
  }
  k_mutex_unlock(&sc_error_module_data_mutex);

  // TODO: no asserts in error module, print error if possible, optionally with the module name
  return false;
}



static void sc_error_log_ext(uint8_t module_index, uint8_t error, bool has_param, uint32_t param)
{
  sc_error_module_data *module = &sc_error_module_data_list[module_index];
  // TODO: should use the real max module_index, not the define
  if (module_index < SC_ERROR_MODULE_MAX &&
      module->name != NULL &&
      error < module->data_size) {

    module->data[error].count++;
    module->data[error].ts = k_uptime_get();
    // TODO: should not use kprint but uart etc.
    // TODO: kprint (with optional param)
    printk("error: %lld, %s, %d, %s\n", module->data[error].ts, module->name, error, module->data[error].message);
    // TODO: Optionally assert?
  } else {
    // TODO: print error about error
    printk("sc_error_log_ext failed\n");
    // TODO: Optionally assert?
  }
}



void sc_error_log(uint8_t module, uint8_t error)
{
  sc_error_log_ext(module, error, false, 0);
}



void sc_error_log_int(uint8_t module, uint8_t error, uint32_t param)
{
  sc_error_log_ext(module, error, true, param);
}
```

## src/sc_event.c
```c
/*
 * Copyright 2018 Tuomas Kulve, <tuomas@kulve.fi>
 *
 * SPDX-License-Identifier: Apache-2.0
 */

#include "sc.h"

#include <string.h>

#ifndef SC_EVENT_MAX_TYPE
#define SC_EVENT_MAX_TYPE 16
#endif

#ifndef SC_EVENT_QUEUE_SIZE
#define SC_EVENT_QUEUE_SIZE 64
#endif

#ifndef SC_EVENT_THREAD_STACK_SIZE
#define SC_EVENT_THREAD_STACK_SIZE 2048
#endif

/* NOTE! This list must be in the same order as the error list below */
typedef enum sc_error_event {
  SC_ERROR_EVENT_K_MSGQ_GET = 0,
  SC_ERROR_EVENT_LOOP_UNKNOWN_EVENT,
  SC_ERROR_EVENT_POST_UNKNOWN_EVENT,
  SC_ERROR_EVENT_NO_CALLBACK,
  SC_ERROR_EVENT_MSGQ_PUT,
  SC_ERROR_EVENT_GET_INVALID_PARAMETER,
  SC_ERROR_EVENT_GET_MODULE_OVERFLOW,
  SC_ERROR_EVENT_NOT_INITIALIZED,
  SC_ERROR_EVENT_REGCB_MODULE_UNKNOWN,
  SC_ERROR_EVENT_REGCB_ALREADY_REGISTERED,
  SC_ERROR_EVENT_COUNT,
} sc_error_event;

/* NOTE! This list must be in the same order as the enum above */
static sc_error_data sc_error_list[SC_ERROR_EVENT_COUNT] = {
  {0, 0, "k_msgq_get failed"},
  {0, 0, "loop: unknown event"},
  {0, 0, "post: unknown event"},
  {0, 0, "no callback function set"},
  {0, 0, "k_msgq_put failed"},
  {0, 0, "get: invalid parameter"},
  {0, 0, "get: module overflow"},
  {0, 0, "not initialized"},
  {0, 0, "reg_cb: module overflow"},
  {0, 0, "reg_cb: already registered"},
};

static uint8_t error_module;

typedef struct sc_event_type_t {
  const char *name;
  sc_event_cb cb;
} sc_event_type;

static sc_event_type sc_event_type_list[SC_EVENT_MAX_TYPE];

K_MUTEX_DEFINE(sc_event_data_mutex);

K_MSGQ_DEFINE(sc_event_msgq, sizeof(uint32_t), SC_EVENT_QUEUE_SIZE, 4);

void sc_event_loop(void *, void *, void *);

K_THREAD_DEFINE(sc_event_thread, SC_EVENT_THREAD_STACK_SIZE,
                sc_event_loop, NULL, NULL, NULL,
                SC_THREAD_PRIORITY_HIGH, K_ESSENTIAL, K_NO_WAIT);

static bool is_initialized = false;

/*
 * Setup a working area for the event loop thread
 */
void sc_event_loop(void *arg1, void *arg2, void *arg3)
{
  (void)arg1;
  (void)arg2;
  (void)arg3;

  if (sc_error_register("EVENT", sc_error_list, ARRAY_SIZE(sc_error_list), &error_module) == false) {
    sc_halt();
  }

  /* TODO: Init not needed for event loop?
  * Maybe it's needed to verify that the loop thread is actually running.
  * Maybe it actually doesn't even need to be running before it can already be used
  * */
  while (is_initialized == false) {
    k_sleep(1);
  }

  while (true) {
    uint32_t type;

    int ret = k_msgq_get(&sc_event_msgq, &type, K_FOREVER);
    if (ret != 0) {
      sc_error_log(error_module, SC_ERROR_EVENT_K_MSGQ_GET);
      continue;
    }

    // TODO: use the real amount of registered events, not the allocated max
    if (type >= SC_EVENT_MAX_TYPE) {
      sc_error_log_int(error_module, SC_ERROR_EVENT_LOOP_UNKNOWN_EVENT, type);
      continue;
    }

    if (sc_event_type_list[type].cb == NULL) {
      sc_error_log(error_module, SC_ERROR_EVENT_NO_CALLBACK);
      continue;
    }

    sc_event_type_list[type].cb();
  }
}



/*
* Initialize the event loop
* Returns true on success
*/
bool sc_event_init(void)
{
  is_initialized = true;

  return true;
}



/*
 * Post an event.
 * Returns true on success
 */
bool sc_event_post(uint8_t type)
{
  if (is_initialized == false) {
    sc_error_log(error_module, SC_ERROR_EVENT_NOT_INITIALIZED);
    return false;
  }

  // TODO: use the real amount of registered events, not the allocated max
  if (type >= SC_EVENT_MAX_TYPE) {
    sc_error_log_int(error_module, SC_ERROR_EVENT_POST_UNKNOWN_EVENT, type);
    return false;
  }

  /* No need to post if there's nobody listening */
  if (!sc_event_type_list[type].cb) {
    return false;
  }

  uint32_t type_msg = type;
  int ret = k_msgq_put(&sc_event_msgq, &type_msg, K_NO_WAIT);
  if (ret != 0) {
    sc_error_log_int(error_module, SC_ERROR_EVENT_MSGQ_PUT, ret);
    return false;
  }

  return true;
}



/*
 * Query the type number for the given type name. Will be initialized on the first call.
 * Return true on success
 */
bool sc_event_register_type(const char *name, uint8_t *type)
{

  if (name == NULL || type == NULL) {
    sc_error_log(error_module, SC_ERROR_EVENT_GET_INVALID_PARAMETER);
    return false;
  }

  k_mutex_lock(&sc_event_data_mutex, K_FOREVER);
  for (uint8_t i = 0; i < SC_EVENT_MAX_TYPE; ++i) {

    // Found empty slot, register new
    if (sc_event_type_list[i].name == NULL) {
      sc_event_type_list[i].name = name;
      *type = i;
      k_mutex_unlock(&sc_event_data_mutex);
      return true;
    }

    // Found registered event
    if (strcmp(name, sc_event_type_list[i].name) == 0) {
      *type = i;
      k_mutex_unlock(&sc_event_data_mutex);
      return true;
    }
  }
  k_mutex_unlock(&sc_event_data_mutex);

  sc_error_log(error_module, SC_ERROR_EVENT_GET_MODULE_OVERFLOW);
  return false;
}



/*
 * Register a callback for the given type. The type must have been queried using sc_event_type_get().
 * Returns true on success
 */
bool sc_event_register_cb(uint8_t type, sc_event_cb func)
{
  // TODO: use the real amount of registered events, not the allocated max
  if (type >= SC_EVENT_MAX_TYPE) {
    sc_error_log_int(error_module, SC_ERROR_EVENT_REGCB_MODULE_UNKNOWN, type);
    return false;
  }

  if (sc_event_type_list[type].cb != NULL) {
    sc_error_log_int(error_module, SC_ERROR_EVENT_REGCB_ALREADY_REGISTERED, type);
    return false;
  }

  sc_event_type_list[type].cb = func;

  return true;
}


bool sc_event_register_type_cb(const char *name, sc_event_cb func)
{
  uint8_t type;
  if (sc_event_register_type(name, &type) == false) {
    return false;
  }
  if (sc_event_register_cb(type, func) == false) {
    // TODO: event is now registered. Does it matter?
    return false;
  }
  return true;
}
```

## src/sc_sensor.c
```c
/*
 * Copyright 2019 Tuomas Kulve, <tuomas@kulve.fi>
 *
 * SPDX-License-Identifier: Apache-2.0
 */

#include "sc_sensor.h"

#ifdef CONFIG_SENSOR

#ifndef SC_SENSOR_MAX
#define SC_SENSOR_MAX 2
#endif

#ifndef SC_SENSOR_CHANNEL_MAX
#define SC_SENSOR_CHANNEL_MAX 4
#endif

#ifndef SC_SENSOR_THREAD_STACK_SIZE
#define SC_SENSOR_THREAD_STACK_SIZE 2048
#endif

typedef struct sc_sensor {
  bool enabled;
  uint64_t next_poll_time;
  struct device *dev;
  enum sensor_channel channels[SC_SENSOR_CHANNEL_MAX];
  uint8_t channel_count;
  uint32_t interval_ms;
  const char *event_name;
  uint8_t event_type;
  struct sensor_value values[SC_SENSOR_CHANNEL_MAX];
} sc_sensor;


static sc_sensor sc_sensor_list[SC_SENSOR_MAX];

K_MUTEX_DEFINE(sc_sensor_data_mutex);

void sc_sensor_loop(void *, void *, void *);

K_THREAD_DEFINE(sc_sensor_thread, SC_SENSOR_THREAD_STACK_SIZE,
                sc_sensor_loop, NULL, NULL, NULL,
                SC_THREAD_PRIORITY_MEDIUM, 0, K_NO_WAIT);

static bool sc_sensor_read(sc_sensor *s);

/*
 * Sensor polling thread
 */
void sc_sensor_loop(void *arg1, void *arg2, void *arg3)
{
  (void)arg1;
  (void)arg2;
  (void)arg3;

  while (true) {
    s64_t now = k_uptime_get();
    s64_t next_poll_time = now + 24*60*60*1000; // Sleep 24 hrs by default

    k_mutex_lock(&sc_sensor_data_mutex, K_FOREVER);

    for (uint8_t i = 0; i < SC_SENSOR_MAX; ++i) {
      sc_sensor *s = &sc_sensor_list[i];
      if (s->enabled == false) {
        continue;
      }

      if (now >= s->next_poll_time) {
        s->next_poll_time += s->interval_ms;
        sc_sensor_read(s);
      }

      if (s->next_poll_time < next_poll_time) {
        next_poll_time = s->next_poll_time;
      }
    }

    k_mutex_unlock(&sc_sensor_data_mutex);

    // No need to worry about getting woken up too soon, the while loop will
    // just cause a new sleep.
    s64_t sleep_time = next_poll_time - now;
    //printk("Sleeping %lld ms until %lld\n", sleep_time, next_poll_time);
    k_sleep(sleep_time);
  }
}


/*
 * Initialize the sensor thread.
 * Returns true on success
 */
bool sc_sensor_init(void)
{
  // Nothing to do here.

  return true;
}


/*
 * Add sensor to the list of sensor to be periodically polled.
 * Returns true on success.
 */
bool sc_sensor_add(const char *device_name,
                   enum sensor_channel *channels,
                   uint8_t channel_count,
                   uint32_t interval_ms,
                   const char *event_name,
                   uint8_t *index)
{
  k_mutex_lock(&sc_sensor_data_mutex, K_FOREVER);

  for (uint8_t i = 0; i < SC_SENSOR_MAX; ++i) {
    sc_sensor *s = &sc_sensor_list[i];
    if (s->enabled == true) {
      continue;
    }

    struct device *dev = device_get_binding(device_name);
    if (dev == NULL) {
      // TODO: log an error
      k_mutex_unlock(&sc_sensor_data_mutex);
      return false;
    }

    s->dev = dev;
    // TODO: do we need to check that channel_count > 8?
    s->channel_count = channel_count;
    for (uint8_t c = 0; c < channel_count; ++c) {
      s->channels[c] = channels[c];
    }
    s->interval_ms = interval_ms;
    s->event_name = event_name;
    s->next_poll_time = k_uptime_get() + interval_ms;
    s->enabled = true;

    // Register test event type and callback
    if (!sc_event_register_type(s->event_name, &s->event_type)){
      k_mutex_unlock(&sc_sensor_data_mutex);
      return false;
    }

    k_mutex_unlock(&sc_sensor_data_mutex);
    return true;
  }
  k_mutex_unlock(&sc_sensor_data_mutex);

  // TODO: log an overflow error
  return false;
}

/*
 * Get the latest sensor read value.
 *
 * Returns true on success.
 */
bool sc_sensor_get_value(uint8_t index, struct sensor_value *values)
{
  // TODO: add boundary check for index
  // TODO: add null check for value

  sc_sensor *s = &sc_sensor_list[index];

  // Note: Once enabled, the sensor cannot be ever disabled. No need to lock the mutex for this check
  if (s->enabled == false) {
    // TODO: report an error?
    return false;
  }

  k_mutex_lock(&sc_sensor_data_mutex, K_FOREVER);
  for (uint8_t c = 0; c < s->channel_count; ++c) {
    values[c] = s->values[c];
  }
  k_mutex_unlock(&sc_sensor_data_mutex);

  return true;
}



int sc_sensor_value_snprintf(char *buf, size_t len,
                             const struct sensor_value *val)
{
  s32_t val1, val2;

  if (val->val2 == 0) {
    return snprintf(buf, len, "%d", val->val1);
  }

  /* normalize value */
  if (val->val1 < 0 && val->val2 > 0) {
    val1 = val->val1 + 1;
    val2 = val->val2 - 1000000;
  } else {
    val1 = val->val1;
    val2 = val->val2;
  }

  /* print value to buffer */
  if (val1 > 0 || (val1 == 0 && val2 > 0)) {
    return snprintf(buf, len, "%d.%06d", val1, val2);
  } else if (val1 == 0 && val2 < 0) {
    return snprintf(buf, len, "-0.%06d", -val2);
  } else {
    return snprintf(buf, len, "%d.%06d", val1, -val2);
  }
}

/*
 * Read a single sensor for a single channel.
 *
 * Returns true on success
 */
static bool sc_sensor_read(sc_sensor *s)
{
  int ret = 0;

  //printk("Reading sensor\n");

  // Unlock during the possible slow sample fetch
  // Note: We can unlock here as a sensor cannot be changed. Only new
  // ones can be added.
  k_mutex_unlock(&sc_sensor_data_mutex);
  ret = sensor_sample_fetch(s->dev);
  k_mutex_lock(&sc_sensor_data_mutex, K_FOREVER);

  if (ret != 0) {
    // TODO: error logging
    printk("Failed to sample fetch: %d\n", ret);
    return false;
  }

  for (uint8_t c = 0; c < s->channel_count; ++c) {
    ret = sensor_channel_get(s->dev, s->channels[c], &s->values[c]);
    if (ret != 0) {
      // TODO: error logging
      printk("Failed to sample fetch: %d\n", ret);
      return false;
    }
  }


  if (!sc_event_post(s->event_type)) {
    // TODO: Error logging
    printk("Failed sc_event_post\n");
    return false;
  }

  return true;
}

#endif // CONFIG_SENSOR
```
